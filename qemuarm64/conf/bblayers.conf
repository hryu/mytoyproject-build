## qemuarm64/conf/bblayers.conf
```bitbake
# POKY_BBLAYERS_CONF_VERSION is increased each time build/conf/bblayers.conf
# changes incompatibly
POKY_BBLAYERS_CONF_VERSION = "2"

BBPATH = "${TOPDIR}"
BBFILES ?= ""

BBLAYERS ?= " \
  ${TOPDIR}/../../yocto/poky/meta \
  ${TOPDIR}/../../yocto/poky/meta-poky \
  ${TOPDIR}/../../yocto/poky/meta-yocto-bsp \
  ${TOPDIR}/../../yocto/meta-openembedded/meta-filesystems \
  ${TOPDIR}/../../yocto/meta-openembedded/meta-gnome \
  ${TOPDIR}/../../yocto/meta-openembedded/meta-initramfs \
  ${TOPDIR}/../../yocto/meta-openembedded/meta-multimedia \
  ${TOPDIR}/../../yocto/meta-openembedded/meta-networking \
  ${TOPDIR}/../../yocto/meta-openembedded/meta-oe \
  ${TOPDIR}/../../yocto/meta-openembedded/meta-perl \
  ${TOPDIR}/../../yocto/meta-openembedded/meta-python \
  ${TOPDIR}/../../yocto/meta-openembedded/meta-webserver \
  ${TOPDIR}/../../yocto/meta-openembedded/meta-xfce \
  ${TOPDIR}/../../yocto/meta-intel \
  ${TOPDIR}/../../yocto/meta-raspberrypi \
  ${TOPDIR}/../../yocto/meta-virtualization \
  ${TOPDIR}/../../yocto/meta-mytoyproject \
  "
```

## raspberrypi3-64/conf/bblayers.conf
```bitbake
# POKY_BBLAYERS_CONF_VERSION is increased each time build/conf/bblayers.conf
# changes incompatibly
POKY_BBLAYERS_CONF_VERSION = "2"

BBPATH = "${TOPDIR}"
BBFILES ?= ""

BBLAYERS ?= " \
  /home/pokyuser/mytoyproject/yocto/poky/meta \
  /home/pokyuser/mytoyproject/yocto/poky/meta-poky \
  /home/pokyuser/mytoyproject/yocto/poky/meta-yocto-bsp \
  /home/pokyuser/mytoyproject/yocto/meta-raspberrypi \
  /home/pokyuser/mytoyproject/yocto/meta-openembedded/meta-oe \
  /home/pokyuser/mytoyproject/yocto/meta-openembedded/meta-filesystems \
  /home/pokyuser/mytoyproject/yocto/meta-openembedded/meta-networking \
  /home/pokyuser/mytoyproject/yocto/meta-openembedded/meta-python \
  /home/pokyuser/mytoyproject/yocto/meta-virtualization \
  /home/pokyuser/mytoyproject/yocto/meta-mytoyproject \
  "
```
